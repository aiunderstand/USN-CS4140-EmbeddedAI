## CMakeLists.txt
```
# SPDX-License-Identifier: Apache-2.0

cmake_minimum_required(VERSION 3.20.0)
find_package(Zephyr REQUIRED HINTS $ENV{ZEPHYR_BASE})
project(servo_motor_pwm_polling_buttons)

target_sources(app PRIVATE
  src/main.c
  src/servo.c
  src/buttons.c
)
```

## prj.conf
```kconfig
CONFIG_STDOUT_CONSOLE=y
CONFIG_PRINTK=y
CONFIG_PWM=y
CONFIG_GPIO=y
```

## boards/nrf54l15dk_nrf54l15_cpuapp.overlay
```dts
/* No overlay needed — pwm20 is already enabled and routed to P1.10
 * by the board's common DTS (nrf54l15dk_common.dtsi). */
```

## src/main.c
```c
/* SPDX-License-Identifier: Apache-2.0 */

#include <zephyr/kernel.h>
#include <zephyr/sys/printk.h>
#include "servo.h"
#include "buttons.h"

/* Polling interval — also acts as a simple debounce delay. */
#define POLL_MS 150

int main(void)
{
	int ret;

	printk("Servo motor control — Button 2: left, Button 3: right\n");

	ret = servo_init();
	if (ret < 0) {
		printk("Error %d: servo init failed\n", ret);
		return 0;
	}

	ret = buttons_init();
	if (ret < 0) {
		printk("Error %d: buttons init failed\n", ret);
		return 0;
	}

	printk("Ready — initial pulse: %u us\n", SERVO_MIN_PULSE / 1000U);

	while (1) {
		if (button_left_pressed()) {
			servo_step_left();
		} else if (button_right_pressed()) {
			servo_step_right();
		}
		k_msleep(POLL_MS);
	}

	return 0;
}
```

## src/buttons.c
```c
/* SPDX-License-Identifier: Apache-2.0 */

#include "buttons.h"

#include <zephyr/drivers/gpio.h>
#include <zephyr/sys/printk.h>

static const struct gpio_dt_spec btn_left  = GPIO_DT_SPEC_GET(DT_ALIAS(sw2), gpios);
static const struct gpio_dt_spec btn_right = GPIO_DT_SPEC_GET(DT_ALIAS(sw3), gpios);

static int configure_button(const struct gpio_dt_spec *btn)
{
	if (!gpio_is_ready_dt(btn)) {
		printk("Error: GPIO %s not ready\n", btn->port->name);
		return -ENODEV;
	}

	return gpio_pin_configure_dt(btn, GPIO_INPUT);
}

int buttons_init(void)
{
	int ret;

	ret = configure_button(&btn_left);
	if (ret < 0) {
		return ret;
	}

	return configure_button(&btn_right);
}

bool button_left_pressed(void)
{
	return gpio_pin_get_dt(&btn_left) > 0;
}

bool button_right_pressed(void)
{
	return gpio_pin_get_dt(&btn_right) > 0;
}
```

## src/buttons.h
```c
/* SPDX-License-Identifier: Apache-2.0 */

#ifndef BUTTONS_H_
#define BUTTONS_H_

#include <stdbool.h>

/**
 * @brief Initialise Button 2 (sw2, left) and Button 3 (sw3, right) as inputs.
 *
 * @return 0 on success, negative errno on failure.
 */
int buttons_init(void);

/** @brief Return true if Button 2 (left) is currently pressed. */
bool button_left_pressed(void);

/** @brief Return true if Button 3 (right) is currently pressed. */
bool button_right_pressed(void);

#endif /* BUTTONS_H_ */
```

## src/servo.c
```c
/* SPDX-License-Identifier: Apache-2.0 */

#include "servo.h"

#include <zephyr/sys/printk.h>
#include <zephyr/drivers/pwm.h>

/* Reuse the board's existing pwm_led1 node (pwm20 ch0, 20 ms period, P1.10).
 * No custom overlay or binding file required. */
static const struct pwm_dt_spec spec = PWM_DT_SPEC_GET(DT_NODELABEL(pwm_led1));

static uint32_t pulse_width;

int servo_init(void)
{
	if (!pwm_is_ready_dt(&spec)) {
		printk("Error: PWM device %s is not ready\n", spec.dev->name);
		return -ENODEV;
	}

	pulse_width = SERVO_MIN_PULSE;

	return pwm_set_pulse_dt(&spec, pulse_width);
}

void servo_step_left(void)
{
	if (pulse_width > SERVO_MIN_PULSE) {
		pulse_width -= SERVO_STEP;
	}
	pwm_set_pulse_dt(&spec, pulse_width);
	printk("Left  — pulse: %u us\n", pulse_width / 1000U);
}

void servo_step_right(void)
{
	if (pulse_width < SERVO_MAX_PULSE) {
		pulse_width += SERVO_STEP;
	}
	pwm_set_pulse_dt(&spec, pulse_width);
	printk("Right — pulse: %u us\n", pulse_width / 1000U);
}
```

## src/servo.h
```c
/* SPDX-License-Identifier: Apache-2.0 */

#ifndef SERVO_H_
#define SERVO_H_

#include <zephyr/drivers/pwm.h>

/** Pulse width limits and step size (nanoseconds). */
#define SERVO_MIN_PULSE PWM_USEC(1000)
#define SERVO_MAX_PULSE PWM_USEC(2000)
#define SERVO_STEP      PWM_USEC(100)

/**
 * @brief Initialise the PWM output and drive the servo to the minimum position.
 *
 * @return 0 on success, negative errno on failure.
 */
int servo_init(void);

/**
 * @brief Step the servo one increment toward the minimum position.
 */
void servo_step_left(void);

/**
 * @brief Step the servo one increment toward the maximum position.
 */
void servo_step_right(void);

#endif /* SERVO_H_ */
```
